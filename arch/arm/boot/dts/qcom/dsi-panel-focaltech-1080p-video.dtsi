//sunjingtao@wind-mobi.com modify at 20180306 begin
/* Copyright (c) 2015-2016, The Linux Foundation. All rights reserved.
 *
 * This program is free software; you can redistribute it and/or modify
 * it under the terms of the GNU General Public License version 2 and
 * only version 2 as published by the Free Software Foundation.
 *
 * This program is distributed in the hope that it will be useful,
 * but WITHOUT ANY WARRANTY; without even the implied warranty of
 * MERCHANTABILITY or FITNESS FOR A PARTICULAR PURPOSE.  See the
 * GNU General Public License for more details.
 */

&mdss_mdp {
	dsi_focaltech_1080_vid: qcom,mdss_dsi_focaltech_1080p_video {
		qcom,mdss-dsi-panel-name = "focaltech 1080p video mode dsi panel";
		qcom,mdss-dsi-panel-controller = <&mdss_dsi0>;
		qcom,mdss-dsi-panel-type = "dsi_video_mode";
		qcom,mdss-dsi-panel-destination = "display_1"; //
		qcom,mdss-dsi-panel-framerate = <60>;
		qcom,mdss-dsi-virtual-channel-id = <0>;
		qcom,mdss-dsi-stream = <0>;
		qcom,mdss-dsi-panel-width = <1200>;
		qcom,mdss-dsi-panel-height = <1920>;
		qcom,mdss-dsi-h-front-porch = <12>;
		qcom,mdss-dsi-h-back-porch = <12>;
		qcom,mdss-dsi-h-pulse-width = <8>;
		qcom,mdss-dsi-h-sync-skew = <0>;
		qcom,mdss-dsi-v-back-porch = <32>;
		qcom,mdss-dsi-v-front-porch = <155>;
		qcom,mdss-dsi-v-pulse-width = <8>;
		qcom,mdss-dsi-h-left-border = <0>;
		qcom,mdss-dsi-h-right-border = <0>;
		qcom,mdss-dsi-v-top-border = <0>;
		qcom,mdss-dsi-v-bottom-border = <0>;
		qcom,mdss-dsi-bpp = <24>;
		qcom,mdss-dsi-color-order = "rgb_swap_rgb";
		qcom,mdss-dsi-underflow-color = <0xff>;
		qcom,mdss-dsi-border-color = <0>;
		qcom,mdss-dsi-h-sync-pulse = <1>;
		qcom,mdss-dsi-traffic-mode = "burst_mode";
		qcom,mdss-dsi-lane-map = "lane_map_0123";
		qcom,mdss-dsi-bllp-eof-power-mode;
		qcom,mdss-dsi-bllp-power-mode;
		qcom,mdss-dsi-lane-0-state;
		qcom,mdss-dsi-lane-1-state;
		qcom,mdss-dsi-lane-2-state;
		qcom,mdss-dsi-lane-3-state;
		qcom,mdss-dsi-panel-timings = [F2 3A 28 00 6C 70 2C 3E 2E 03 04 00];
		qcom,mdss-dsi-t-clk-post = <0x0e>;
		qcom,mdss-dsi-t-clk-pre = <0x31>;
		qcom,mdss-dsi-bl-min-level = <1>;
		qcom,mdss-dsi-bl-max-level = <3768>;
		qcom,mdss-dsi-dma-trigger = "trigger_sw";
		qcom,mdss-dsi-mdp-trigger = "none";
		qcom,mdss-dsi-on-command = [15 01 00 00 78 00 02 11 00
		39 01 00 00 00 00 03 50 5a 0e
		39 01 00 00 00 00 0d 80 ff 81 68 6c 22 6d 12 00 00 00 00 00
		39 01 00 00 00 00 03 50 5a 23
		39 01 00 00 00 00 03 90 00 00
		39 01 00 00 00 00 03 94 2c 00
		39 01 00 00 00 00 03 50 5a 19
		39 01 00 00 00 00 02 A2 38
		39 01 00 00 00 00 03 50 5a 15
		39 01 00 00 00 00 11 D0 6D Db B6 5D AB E8 E3 82 A1 38 92 65 6A DB B6 6D
		39 01 00 00 00 00 11 F0 B6 6D DB B6 5D 29 E8 E3 00 81 30 10 45 6A 5B 00
		29 01 00 00 00 00 03 50 5a 0c
		29 01 00 00 00 00 02 80 fd
		29 01 00 00 00 00 02 50 00  
		15 01 00 00 14 00 02 29 00];
		qcom,mdss-dsi-off-command = [15 01 00 00 46 00 02 28 00
				 15 01 00 00 14 00 02 10 00
				 15 01 00 00 00 00 02 04 5a
				 15 01 00 00 96 00 02 05 5a];
		qcom,mdss-dsi-on-command-state = "dsi_lp_mode";
		qcom,mdss-dsi-off-command-state = "dsi_lp_mode";
		qcom,mdss-dsi-bl-pmic-control-type = "bl_ctrl_dcs";
		qcom,mdss-dsi-reset-sequence = <1 5>, <0 5>, <1 35>;
		qcom,mdss-dsi-tx-eot-append;
		qcom,mdss-dsi-post-init-delay = <1>;
	};
};
//sunjingtao@wind-mobi.com modify at 20180306 end
