/*
 * Copyright (c) 2015, The Linux Foundation. All rights reserved.
 *
 * This program is free software; you can redistribute it and/or modify
 * it under the terms of the GNU General Public License version 2 and
 * only version 2 as published by the Free Software Foundation.
 *
 * This program is distributed in the hope that it will be useful,
 * but WITHOUT ANY WARRANTY; without even the implied warranty of
 * MERCHANTABILITY or FITNESS FOR A PARTICULAR PURPOSE.  See the
 * GNU General Public License for more details.
 */

qcom,ascent-3450mah {
	/* #Ascent_860_82209_0000_3450mAh_averaged_MasterSlave_Sept28th2015*/
	qcom,max-voltage-uv = <4400000>;
	qcom,fg-cc-cv-threshold-mv = <4390>;
	qcom,nom-batt-capacity-mah = <4850>;
	qcom,batt-id-kohm = <0>;
	qcom,battery-beta = <3380>;
	qcom,battery-type = "4850mah_0k";
	qcom,chg-rslow-comp-c1 = <2620265>;
	qcom,chg-rslow-comp-c2 = <2892360>;
	qcom,chg-rs-to-rslow = <603378>;
	qcom,chg-rslow-comp-thr = <0x99>;
	qcom,checksum = <0xB270>;
	qcom,gui-version = "PMI8950GUI - 2.0.0.16";
	qcom,fg-profile-data = [
		 DE 83 8F 7C 
		 BB 80 3A 76 
		 3B 83 A6 73 
		 71 84 22 81 
		 1D 82 2B 9B 
		 2E BF ED D0 
		 75 0F FC 83 
		 7F 7D 8F 81 
		 0C 7C 33 83 
		 E9 79 23 8C 
		 96 88 25 82 
		 DD 9B 78 C4 
		 07 D3 69 0D 
		 79 13 1E 59 
		 14 70 29 FC 
		 4C 46 14 36 
		 56 42 00 00 
		 C5 47 D1 40 
		 1D 36 00 00 
		 00 00 00 00 
		 00 00 00 00 
		 84 69 A5 68 
		 E2 6A 49 83 
		 54 74 93 63 
		 C5 5A E6 7A 
		 B2 6F 7A 63 
		 2F 74 AB A0 
		 1D BA 60 BD 
		 5D A0 71 0C 
		 28 00 FF 36 
		 F0 11 30 03 
		 00 00 00 0C 
	];
};
