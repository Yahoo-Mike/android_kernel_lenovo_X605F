## drivers/misc/wantjoin/Kconfig
```kconfig
#mahui01@wind-mobi.com 2018/9/17 add for lenovo CSDK begin

menu	"Wantjoin software Configuration"

config WANTJOIN_FIREWALL
	tristate "wantjoin co. ltd firewall core"
	depends on NETFILTER
	default n
	help
	  A firewall module. Say Y when you want to support this tool.

endmenu
#mahui01@wind-mobi.com 2018/9/17 add for lenovo CSDK end
```

## drivers/tlmm/Kconfig
```kconfig
#sunsiyuan@wind-mobi.com modify at 20180510 begin
config TLMM
	bool "TLMM"
	help
		detect sim tray status
#sunsiyuan@wind-mobi.com modify at 20180510 end
```
